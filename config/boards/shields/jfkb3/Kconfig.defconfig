## config/boards/shields/jfkb3/Kconfig.defconfig
```kconfig
if SHIELD_JFKB3

config ZMK_KEYBOARD_NAME
    default "jfkb3"

CONFIG_BT=y
CONFIG_BT_PERIPHERAL=y
CONFIG_BT_HIDS=y

CONFIG_ZMK_BLE=y
CONFIG_ZMK_BLE_PERIPHERAL=y

CONFIG_BT_DEVICE_NAME="MyKeyboard"

CONFIG_USB_DEVICE_STACK=y
CONFIG_USB_DEVICE_PRODUCT="MyKeyboard"
CONFIG_ZMK_USB=y
CONFIG_ZMK_USB_DEVICE=y

CONFIG_PM=y
CONFIG_PM_DEVICE=y

CONFIG_ZMK_BACKLIGHT=y
CONFIG_ZMK_BACKLIGHT_BRT_STEP=20
CONFIG_ZMK_BACKLIGHT_BRT_START=40
CONFIG_ZMK_BACKLIGHT_ON_START=y
CONFIG_ZMK_BACKLIGHT_AUTO_OFF_IDLE=n
CONFIG_ZMK_BACKLIGHT_AUTO_OFF_USB=n

endif

if ZMK_BACKLIGHT

config PWM
    default y

config LED_PWM
    default y

endif # ZMK_BACKLIGHT
```

## config/boards/shields/jfkb3/Kconfig.shield
```kconfig
config SHIELD_JFKB3"
    def_bool $(shields_list_contains,JFKB3)
    CONFIG_CLOCK_CONTROL_NRF_K32SRC_RC=y
```
